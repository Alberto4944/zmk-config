## config/boards/shields/hacker-keeb/Kconfig.defconfig
```kconfig
if SHIELD_HACKER_KEEB_LEFT

# Name must be less than 16 characters long!
config ZMK_KEYBOARD_NAME
    default "Hacker Keeb"

config ZMK_SPLIT_ROLE_CENTRAL
    default y

endif

if SHIELD_HACKER_KEEB_LEFT || SHIELD_HACKER_KEEB_RIGHT

config ZMK_SPLIT
    default y

endif
```

## config/boards/shields/hacker-keeb/Kconfig.shield
```kconfig
# No whitespace after the comma or in your part name!
config SHIELD_HACKER_KEEB_LEFT
    def_bool $(shields_list_contains,hacker_keeb_left)

# No whitespace after the comma or in your part name!
config SHIELD_HACKER_KEEB_RIGHT
    def_bool $(shields_list_contains,hacker_keeb_right)
```
